/*@!Encoding:1252*/
includes
{
  
}

variables
{
  message Engine var;
  message AccelerationMSG acclr;
  message BrakeMSG brk;
  message CruiseMSG cc;

  int i=10;
  int q=10;
  int y=10;
}
on start
{
  var.EngineOnOff=1;
  output(var);
}

on message AccelerationMSG
{
  var.Velocity=this.Acceleration;
  output(var);
}
on message BrakeMSG
{
  if(this.Brakes==1)
  {
    var.Velocity=0;
    acclr.Acceleration=0;
  }
}
on key 'a'
{
  if(i<2000)
  {
    i = i + 10;
    acclr.Acceleration=i;
    output(acclr);
    
  }
}
on key 'd'
{
  if(i>0)
  {
    i = i - 10;
    acclr.Acceleration=i;
    output(acclr);
    if(var.Velocity<300)
    {
      cc.CruiseStatus=0;
      output(cc);
    }
  }
}
on key 'b'
{
  brk.Brakes=1;
  i=0;
  output(brk);
}

on sysvar CruiseOnOFF::CruiseControlOnOFF
{
  if(var.Velocity>300)
  {
    cc.CruiseStatus=@CruiseOnOFF::CruiseControlOnOFF;
    cc.CruiseSpeed=0;
    output(cc);
  }
}
on key 'p'
{
  if(var.Velocity>300)
  {
    q=q+1;
    i=i+q;
    cc.CruiseSpeed=i;
    output(cc);
    acclr.Acceleration=i;
    output(acclr);
  }
}
on key 'm'
{
  if(var.Velocity>300)
  {
    y=y+1;
    i=i-y;
    cc.CruiseSpeed=i;
    output(cc);    
    acclr.Acceleration=i;
    output(acclr);
  }
  else
  {  
    cc.CruiseStatus=0;
    output(cc);
  }
}  
on key 'r'
{
  cc.CruiseSpeed=0;
  output(cc);
}
on key 'k'
{
  if(var.Velocity>300 & cc.CruiseSpeed>300)
  {
    cc.CruiseStatus=1;
    i=cc.CruiseSpeed;
    acclr.Acceleration=cc.CruiseSpeed;
    output(acclr);
    cc.CruiseStatus=1;
    output(cc);
  }
}


