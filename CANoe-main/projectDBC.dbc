VERSION ""

NS_ :

BS_:

BU_:

BO_ 866 RPM: 5 Vector__XXX
 SG_ rpm : 0|16@1+ (0.001,0) [0|65.535] "rpm" Vector__XXX

BO_ 768 Indicator: 2 Vector__XXX
 SG_ Right_indicator : 8|1@1+ (1,0) [0|1] "" Vector__XXX
 SG_ Left_indicator : 0|1@1+ (1,0) [0|1] "" Vector__XXX

BO_ 1025 Cruise_Control_Light: 1 Vector__XXX
 SG_ cruise_light : 0|1@1+ (1,0) [0|1] "Boolean" Vector__XXX

BO_ 624 DomeLights: 1 Vector__XXX
 SG_ DomeSignal : 0|1@1+ (1,0) [0|1] "boolean" Vector__XXX

BO_ 1024 LightsCondition: 1 Vector__XXX
 SG_ LightsOnOff : 0|1@1+ (1,0) [0|1] "Boolean" Vector__XXX

BO_ 592 DoorStatus: 1 Vector__XXX
 SG_ Lock_UnlockKey : 0|1@1+ (1,0) [0|1] "Boolean" Vector__XXX

BO_ 512 DoorPhysical: 1 Vector__XXX
 SG_ DoorC_O : 0|1@1+ (1,0) [0|1] "Boolean" Vector__XXX

BO_ 549 CarMode: 1 Vector__XXX
 SG_ ParkMode : 0|1@1+ (1,0) [0|1] "Boolean" Vector__XXX

BO_ 280 Engine: 4 Vector__XXX
 SG_ Velocity : 16|16@1+ (0.1,0) [0|65535] "kmph" Vector__XXX
 SG_ EngineOnOff : 0|1@1+ (1,0) [0|1] "Boolean" Vector__XXX

BO_ 288 BrakeMSG: 1 Vector__XXX
 SG_ Brakes : 0|1@1+ (1,0) [0|1] "Boolean" Vector__XXX

BO_ 290 CruiseMSG: 4 Vector__XXX
 SG_ CruiseSpeed : 16|16@1+ (0.1,0) [0|65535] "" Vector__XXX
 SG_ CruiseStatus : 0|1@1+ (1,0) [0|1] "Boolean" Vector__XXX

BO_ 289 AccelerationMSG: 2 Vector__XXX
 SG_ Acceleration : 0|16@1+ (0.1,0) [0|65535] "m/s^2" Vector__XXX
